## package/python-attrs/Config.in
```kconfig
config BR2_PACKAGE_PYTHON_ATTRS
	bool "python-attrs"
	help
	  Classes Without Boilerplate.

	  https://www.attrs.org/
```

## package/python-importlib-resources/Config.in
```kconfig
config BR2_PACKAGE_PYTHON_IMPORTLIB_RESOURCES
	bool "python-importlib-resources"
	select BR2_PACKAGE_PYTHON_ZIPP # runtime
	help
	  Read resources from Python packages.

	  https://github.com/python/importlib_resources
```

## package/python-jsonschema/Config.in
```kconfig
config BR2_PACKAGE_PYTHON_JSONSCHEMA
	bool "python-jsonschema"
	help
	  An implementation of JSON Schema validation for Python.

	  https://github.com/Julian/jsonschema
```
